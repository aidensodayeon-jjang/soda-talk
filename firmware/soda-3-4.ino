#include <driver/i2s.h>
#include <math.h>
#include <Adafruit_GFX.h>
#include <Adafruit_ST7789.h>
#include <SPI.h>

// ==========================================
// 핀 설정 (소다봇 2.0" LCD + 사운드 + 버튼)
// ==========================================
#define LED_PIN     2
#define BUTTON_PIN  4

// MAX98357A 앰프 (I2S)
#define I2S_BCLK    5
#define I2S_LRC     3
#define I2S_DOUT    44
#define I2S_PORT    I2S_NUM_0
#define SAMPLE_RATE 44100

// Waveshare 2.0" ST7789 LCD (SPI)
#define TFT_MOSI 11
#define TFT_CLK  12
#define TFT_CS   13
#define TFT_DC   7
#define TFT_RST  6

SPIClass hspi(HSPI);
Adafruit_ST7789 tft = Adafruit_ST7789(&hspi, TFT_CS, TFT_DC, TFT_RST);

#define ICON_SIZE 16
#define SCALE 7   // 화면 중앙 확대 배율

// ==========================================
// 🎨 소다봇 표정 비트맵 데이터 (Frame 1 & 2)
// ==========================================
// Frame 1: 평상시 미소
const uint16_t face_frame_1[256] PROGMEM = {
  ST77XX_BLACK, ST77XX_BLACK, ST77XX_BLACK, ST77XX_BLACK, ST77XX_BLACK, ST77XX_BLACK, ST77XX_BLACK, ST77XX_BLACK,
  ST77XX_BLACK, ST77XX_BLACK, ST77XX_BLACK, ST77XX_BLACK, ST77XX_BLACK, ST77XX_BLACK, ST77XX_BLACK, ST77XX_BLACK,
  ST77XX_BLACK, ST77XX_BLACK, ST77XX_BLACK, ST77XX_BLACK, ST77XX_BLACK, ST77XX_BLACK, ST77XX_BLACK, ST77XX_BLACK,
  ST77XX_BLACK, ST77XX_BLACK, ST77XX_BLACK, ST77XX_BLACK, ST77XX_BLACK, ST77XX_BLACK, ST77XX_BLACK, ST77XX_BLACK,
  ST77XX_BLACK, ST77XX_BLACK, ST77XX_WHITE, ST77XX_WHITE, ST77XX_WHITE, ST77XX_BLACK, ST77XX_BLACK, ST77XX_BLACK,
  ST77XX_BLACK, ST77XX_BLACK, ST77XX_BLACK, ST77XX_WHITE, ST77XX_WHITE, ST77XX_WHITE, ST77XX_BLACK, ST77XX_BLACK,
  ST77XX_BLACK, ST77XX_WHITE, ST77XX_WHITE, ST77XX_WHITE, ST77XX_WHITE, ST77XX_WHITE, ST77XX_BLACK, ST77XX_BLACK,
  ST77XX_BLACK, ST77XX_BLACK, ST77XX_WHITE, ST77XX_WHITE, ST77XX_WHITE, ST77XX_WHITE, ST77XX_WHITE, ST77XX_BLACK,
  ST77XX_BLACK, ST77XX_WHITE, ST77XX_WHITE, ST77XX_BLACK, ST77XX_WHITE, ST77XX_WHITE, ST77XX_BLACK, ST77XX_BLACK,
  ST77XX_BLACK, ST77XX_BLACK, ST77XX_WHITE, ST77XX_WHITE, ST77XX_BLACK, ST77XX_WHITE, ST77XX_WHITE, ST77XX_BLACK,
  ST77XX_BLACK, ST77XX_WHITE, ST77XX_WHITE, ST77XX_BLACK, ST77XX_WHITE, ST77XX_WHITE, ST77XX_BLACK, ST77XX_BLACK,
  ST77XX_BLACK, ST77XX_BLACK, ST77XX_WHITE, ST77XX_WHITE, ST77XX_BLACK, ST77XX_WHITE, ST77XX_WHITE, ST77XX_BLACK,
  ST77XX_BLACK, ST77XX_WHITE, ST77XX_WHITE, ST77XX_WHITE, ST77XX_WHITE, ST77XX_WHITE, ST77XX_BLACK, ST77XX_BLACK,
  ST77XX_BLACK, ST77XX_BLACK, ST77XX_WHITE, ST77XX_WHITE, ST77XX_WHITE, ST77XX_WHITE, ST77XX_WHITE, ST77XX_BLACK,
  ST77XX_BLACK, ST77XX_BLACK, ST77XX_WHITE, ST77XX_WHITE, ST77XX_WHITE, ST77XX_BLACK, ST77XX_BLACK, ST77XX_BLACK,
  ST77XX_BLACK, ST77XX_BLACK, ST77XX_BLACK, ST77XX_WHITE, ST77XX_WHITE, ST77XX_WHITE, ST77XX_BLACK, ST77XX_BLACK,
  ST77XX_BLACK, ST77XX_BLACK, ST77XX_BLACK, ST77XX_BLACK, ST77XX_BLACK, ST77XX_BLACK, ST77XX_BLACK, ST77XX_BLACK,
  ST77XX_BLACK, ST77XX_BLACK, ST77XX_BLACK, ST77XX_BLACK, ST77XX_BLACK, ST77XX_BLACK, ST77XX_BLACK, ST77XX_BLACK,
  ST77XX_BLACK, ST77XX_RED,   ST77XX_BLACK, ST77XX_BLACK, ST77XX_BLACK, ST77XX_BLACK, ST77XX_BLACK, ST77XX_BLACK,
  ST77XX_BLACK, ST77XX_BLACK, ST77XX_BLACK, ST77XX_BLACK, ST77XX_BLACK, ST77XX_BLACK, ST77XX_RED,   ST77XX_BLACK,
  ST77XX_BLACK, ST77XX_RED,   ST77XX_RED,   ST77XX_BLACK, ST77XX_BLACK, ST77XX_BLACK, ST77XX_BLACK, ST77XX_BLACK,
  ST77XX_BLACK, ST77XX_BLACK, ST77XX_BLACK, ST77XX_BLACK, ST77XX_BLACK, ST77XX_RED,   ST77XX_RED,   ST77XX_BLACK,
  ST77XX_BLACK, ST77XX_BLACK, ST77XX_BLACK, ST77XX_WHITE, ST77XX_BLACK, ST77XX_BLACK, ST77XX_BLACK, ST77XX_BLACK,
  ST77XX_BLACK, ST77XX_BLACK, ST77XX_BLACK, ST77XX_BLACK, ST77XX_WHITE, ST77XX_BLACK, ST77XX_BLACK, ST77XX_BLACK,
  ST77XX_BLACK, ST77XX_BLACK, ST77XX_BLACK, ST77XX_WHITE, ST77XX_WHITE, ST77XX_BLACK, ST77XX_BLACK, ST77XX_BLACK,
  ST77XX_BLACK, ST77XX_BLACK, ST77XX_BLACK, ST77XX_BLACK, ST77XX_WHITE, ST77XX_WHITE, ST77XX_BLACK, ST77XX_BLACK,
  ST77XX_BLACK, ST77XX_BLACK, ST77XX_BLACK, ST77XX_BLACK, ST77XX_WHITE, ST77XX_WHITE, ST77XX_WHITE, ST77XX_WHITE,
  ST77XX_WHITE, ST77XX_WHITE, ST77XX_WHITE, ST77XX_WHITE, ST77XX_BLACK, ST77XX_BLACK, ST77XX_BLACK, ST77XX_BLACK,
  ST77XX_BLACK, ST77XX_BLACK, ST77XX_BLACK, ST77XX_BLACK, ST77XX_BLACK, ST77XX_BLACK, ST77XX_WHITE, ST77XX_WHITE,
  ST77XX_WHITE, ST77XX_WHITE, ST77XX_BLACK, ST77XX_BLACK, ST77XX_BLACK, ST77XX_BLACK, ST77XX_BLACK, ST77XX_BLACK,
  ST77XX_BLACK, ST77XX_BLACK, ST77XX_BLACK, ST77XX_BLACK, ST77XX_BLACK, ST77XX_BLACK, ST77XX_BLACK, ST77XX_BLACK,
  ST77XX_BLACK, ST77XX_BLACK, ST77XX_BLACK, ST77XX_BLACK, ST77XX_BLACK, ST77XX_BLACK, ST77XX_BLACK, ST77XX_BLACK
};

// Frame 2: 버튼 눌렀을 때 활짝 웃는 표정
const uint16_t face_frame_2[256] PROGMEM = {
  ST77XX_BLACK, ST77XX_BLACK, ST77XX_BLACK, ST77XX_BLACK, ST77XX_BLACK, ST77XX_BLACK, ST77XX_BLACK, ST77XX_BLACK,
  ST77XX_BLACK, ST77XX_BLACK, ST77XX_BLACK, ST77XX_BLACK, ST77XX_BLACK, ST77XX_BLACK, ST77XX_BLACK, ST77XX_BLACK,
  ST77XX_BLACK, ST77XX_BLACK, ST77XX_BLACK, ST77XX_BLACK, ST77XX_BLACK, ST77XX_BLACK, ST77XX_BLACK, ST77XX_BLACK,
  ST77XX_BLACK, ST77XX_BLACK, ST77XX_BLACK, ST77XX_BLACK, ST77XX_BLACK, ST77XX_BLACK, ST77XX_BLACK, ST77XX_BLACK,
  ST77XX_BLACK, ST77XX_BLACK, ST77XX_BLACK, ST77XX_BLACK, ST77XX_BLACK, ST77XX_BLACK, ST77XX_BLACK, ST77XX_BLACK,
  ST77XX_BLACK, ST77XX_BLACK, ST77XX_BLACK, ST77XX_BLACK, ST77XX_BLACK, ST77XX_BLACK, ST77XX_BLACK, ST77XX_BLACK,
  ST77XX_BLACK, ST77XX_BLACK, ST77XX_BLACK, ST77XX_BLACK, ST77XX_BLACK, ST77XX_BLACK, ST77XX_BLACK, ST77XX_BLACK,
  ST77XX_BLACK, ST77XX_BLACK, ST77XX_BLACK, ST77XX_BLACK, ST77XX_BLACK, ST77XX_BLACK, ST77XX_BLACK, ST77XX_BLACK,
  ST77XX_BLACK, ST77XX_WHITE, ST77XX_WHITE, ST77XX_WHITE, ST77XX_WHITE, ST77XX_WHITE, ST77XX_BLACK, ST77XX_BLACK,
  ST77XX_BLACK, ST77XX_BLACK, ST77XX_WHITE, ST77XX_WHITE, ST77XX_WHITE, ST77XX_WHITE, ST77XX_WHITE, ST77XX_BLACK,
  ST77XX_BLACK, ST77XX_WHITE, ST77XX_WHITE, ST77XX_WHITE, ST77XX_WHITE, ST77XX_WHITE, ST77XX_BLACK, ST77XX_BLACK,
  ST77XX_BLACK, ST77XX_BLACK, ST77XX_WHITE, ST77XX_WHITE, ST77XX_WHITE, ST77XX_WHITE, ST77XX_WHITE, ST77XX_BLACK,
  ST77XX_BLACK, ST77XX_BLACK, ST77XX_BLACK, ST77XX_BLACK, ST77XX_BLACK, ST77XX_BLACK, ST77XX_BLACK, ST77XX_BLACK,
  ST77XX_BLACK, ST77XX_BLACK, ST77XX_BLACK, ST77XX_BLACK, ST77XX_BLACK, ST77XX_BLACK, ST77XX_BLACK, ST77XX_BLACK,
  ST77XX_BLACK, ST77XX_BLACK, ST77XX_BLACK, ST77XX_BLACK, ST77XX_BLACK, ST77XX_BLACK, ST77XX_BLACK, ST77XX_BLACK,
  ST77XX_BLACK, ST77XX_BLACK, ST77XX_BLACK, ST77XX_BLACK, ST77XX_BLACK, ST77XX_BLACK, ST77XX_BLACK, ST77XX_BLACK,
  ST77XX_BLACK, ST77XX_BLACK, ST77XX_BLACK, ST77XX_BLACK, ST77XX_BLACK, ST77XX_BLACK, ST77XX_BLACK, ST77XX_BLACK,
  ST77XX_BLACK, ST77XX_BLACK, ST77XX_BLACK, ST77XX_BLACK, ST77XX_BLACK, ST77XX_BLACK, ST77XX_BLACK, ST77XX_BLACK,
  ST77XX_BLACK, ST77XX_RED,   ST77XX_RED,   ST77XX_BLACK, ST77XX_BLACK, ST77XX_BLACK, ST77XX_BLACK, ST77XX_BLACK,
  ST77XX_BLACK, ST77XX_BLACK, ST77XX_BLACK, ST77XX_BLACK, ST77XX_BLACK, ST77XX_RED,   ST77XX_RED,   ST77XX_BLACK,
  ST77XX_BLACK, ST77XX_BLACK, ST77XX_BLACK, ST77XX_WHITE, ST77XX_BLACK, ST77XX_BLACK, ST77XX_BLACK, ST77XX_BLACK,
  ST77XX_BLACK, ST77XX_BLACK, ST77XX_BLACK, ST77XX_BLACK, ST77XX_WHITE, ST77XX_BLACK, ST77XX_BLACK, ST77XX_BLACK,
  ST77XX_BLACK, ST77XX_BLACK, ST77XX_BLACK, ST77XX_WHITE, ST77XX_WHITE, ST77XX_WHITE, ST77XX_WHITE, ST77XX_WHITE,
  ST77XX_WHITE, ST77XX_WHITE, ST77XX_WHITE, ST77XX_WHITE, ST77XX_WHITE, ST77XX_BLACK, ST77XX_BLACK, ST77XX_BLACK,
  ST77XX_BLACK, ST77XX_BLACK, ST77XX_BLACK, ST77XX_BLACK, ST77XX_WHITE, ST77XX_WHITE, ST77XX_WHITE, ST77XX_WHITE,
  ST77XX_WHITE, ST77XX_WHITE, ST77XX_WHITE, ST77XX_WHITE, ST77XX_BLACK, ST77XX_BLACK, ST77XX_BLACK, ST77XX_BLACK,
  ST77XX_BLACK, ST77XX_BLACK, ST77XX_BLACK, ST77XX_BLACK, ST77XX_BLACK, ST77XX_WHITE, ST77XX_WHITE, ST77XX_WHITE,
  ST77XX_WHITE, ST77XX_WHITE, ST77XX_WHITE, ST77XX_BLACK, ST77XX_BLACK, ST77XX_BLACK, ST77XX_BLACK, ST77XX_BLACK,
  ST77XX_BLACK, ST77XX_BLACK, ST77XX_BLACK, ST77XX_BLACK, ST77XX_BLACK, ST77XX_BLACK, ST77XX_BLACK, ST77XX_BLACK,
  ST77XX_BLACK, ST77XX_BLACK, ST77XX_BLACK, ST77XX_BLACK, ST77XX_BLACK, ST77XX_BLACK, ST77XX_BLACK, ST77XX_BLACK,
  ST77XX_BLACK, ST77XX_BLACK, ST77XX_BLACK, ST77XX_BLACK, ST77XX_BLACK, ST77XX_BLACK, ST77XX_BLACK, ST77XX_BLACK,
  ST77XX_BLACK, ST77XX_BLACK, ST77XX_BLACK, ST77XX_BLACK, ST77XX_BLACK, ST77XX_BLACK, ST77XX_BLACK, ST77XX_BLACK
};

// ==========================================
// 렌더링 함수
// ==========================================
void drawFace(const uint16_t* bitmap, int startX, int startY, int scale) {
  for (int r = 0; r < ICON_SIZE; r++) {
    for (int c = 0; c < ICON_SIZE; c++) {
      uint16_t color = pgm_read_word(&bitmap[r * ICON_SIZE + c]);
      tft.fillRect(startX + c * scale, startY + r * scale, scale, scale, color);
    }
  }
}

// I2S 사인파 소리 출력
void playTone(float frequency, int duration_ms) {
  const int BUFFER_FRAMES = 128;
  int16_t buffer[BUFFER_FRAMES * 2];
  float phase = 0;
  float step = 2.0 * PI * frequency / SAMPLE_RATE;
  int totalSamples = SAMPLE_RATE * duration_ms / 1000;
  int generated = 0;

  while (generated < totalSamples) {
    int count = min(BUFFER_FRAMES, totalSamples - generated);
    for (int i = 0; i < count; i++) {
      int16_t sample = (int16_t)(sin(phase) * 6000);
      phase += step;
      if (phase >= 2.0 * PI) phase -= 2.0 * PI;
      buffer[i * 2] = sample;
      buffer[i * 2 + 1] = sample;
    }
    size_t bytesWritten;
    i2s_write(I2S_PORT, buffer, count * 2 * sizeof(int16_t), &bytesWritten, portMAX_DELAY);
    generated += count;
  }
  i2s_zero_dma_buffer(I2S_PORT);
}

void setup() {
  Serial.begin(115200);

  pinMode(LED_PIN, OUTPUT);
  pinMode(BUTTON_PIN, INPUT_PULLUP);
  digitalWrite(LED_PIN, LOW);

  // ---- LCD 초기화 ----
  hspi.begin(TFT_CLK, -1, TFT_MOSI, TFT_CS);
  tft.init(240, 320);
  tft.setSPISpeed(4000000);
  tft.setRotation(3);        // 320x240 가로 화면
  tft.invertDisplay(true);
  tft.fillScreen(ST77XX_BLACK);

  // ---- I2S 스피커 설정 ----
  i2s_config_t i2s_config = {
    .mode = (i2s_mode_t)(I2S_MODE_MASTER | I2S_MODE_TX),
    .sample_rate = SAMPLE_RATE,
    .bits_per_sample = I2S_BITS_PER_SAMPLE_16BIT,
    .channel_format = I2S_CHANNEL_FMT_RIGHT_LEFT,
    .communication_format = I2S_COMM_FORMAT_STAND_I2S,
    .intr_alloc_flags = 0,
    .dma_buf_count = 8,
    .dma_buf_len = 256,
    .use_apll = false,
    .tx_desc_auto_clear = true,
    .fixed_mclk = 0
  };
  i2s_pin_config_t pin_config = {
    .bck_io_num = I2S_BCLK,
    .ws_io_num = I2S_LRC,
    .data_out_num = I2S_DOUT,
    .data_in_num = I2S_PIN_NO_CHANGE
  };
  i2s_driver_install(I2S_PORT, &i2s_config, 0, NULL);
  i2s_set_pin(I2S_PORT, &pin_config);

  // 상단 바
  tft.fillRect(0, 0, 320, 24, 0x18E3);
  tft.setTextColor(ST77XX_WHITE);
  tft.setTextSize(2);
  tft.setCursor(10, 4);
  tft.print("SODABOT Face Studio");

  // 기본 Frame 1 표정 출력
  int centerX = (320 - ICON_SIZE * SCALE) / 2;
  int centerY = 30 + (200 - ICON_SIZE * SCALE) / 2;
  drawFace(face_frame_1, centerX, centerY, SCALE);
}

void loop() {
  int centerX = (320 - ICON_SIZE * SCALE) / 2;
  int centerY = 30 + (200 - ICON_SIZE * SCALE) / 2;

  // 버튼을 누르면 Frame 2 표정으로 전환 & 사운드 출력
  if (digitalRead(BUTTON_PIN) == LOW) {
    digitalWrite(LED_PIN, HIGH);
    drawFace(face_frame_2, centerX, centerY, SCALE);

    // 반응 사운드 (도-미-솔)
    playTone(523.25, 80);
    delay(20);
    playTone(659.25, 80);
    delay(20);
    playTone(783.99, 150);

    while (digitalRead(BUTTON_PIN) == LOW) {
      delay(10);
    }
    digitalWrite(LED_PIN, LOW);

    // 버튼에서 손을 떼면 기본 Frame 1 표정으로 복귀
    delay(100);
    drawFace(face_frame_1, centerX, centerY, SCALE);
  }

  delay(20);
}
